## prj.conf
```kconfig
CONFIG_GPIO=y
# App must be built for MCUboot when used as a slot image
CONFIG_BOOTLOADER_MCUBOOT=y
# IMG_MANAGER is a Kconfig <choice>; MCUBOOT_IMG_MANAGER selects the
# mcuboot-specific branch of it. Without this, subsys/dfu/boot/mcuboot.c
# (which defines boot_is_img_confirmed / boot_write_img_confirmed /
# boot_request_upgrade) never gets compiled, regardless of IMG_MANAGER=y.
CONFIG_MCUBOOT_IMG_MANAGER=y
CONFIG_IMG_MANAGER=y
CONFIG_FLASH=y
CONFIG_FLASH_MAP=y
CONFIG_STREAM_FLASH=y
CONFIG_REBOOT=y
```

## src/main.c
```c
/*
 * Copyright (c) 2016 Intel Corporation
 *
 * SPDX-License-Identifier: Apache-2.0
 */

#include <stdio.h>
#include <zephyr/kernel.h>
#include <zephyr/drivers/gpio.h>
#ifdef CONFIG_BOOTLOADER_MCUBOOT
#include <zephyr/dfu/mcuboot.h>
#include <zephyr/sys/reboot.h>
#endif

/* 1000 msec = 1 sec */
#define SLEEP_TIME_MS   1000

/* The devicetree node identifier for the "led0" alias. */
#define LED0_NODE DT_ALIAS(led0)

/*
 * A build error on this line means your board is unsupported.
 * See the sample documentation for information on how to fix this.
 */
static const struct gpio_dt_spec led = GPIO_DT_SPEC_GET(LED0_NODE, gpios);

int main(void)
{
	int ret;
	bool led_state = true;

	if (!gpio_is_ready_dt(&led)) {
		return 0;
	}

	ret = gpio_pin_configure_dt(&led, GPIO_OUTPUT_ACTIVE);
	if (ret < 0) {
		return 0;
	}

	printf("APP: utat-mcuboot (v0, 1000ms)\n");

	#ifdef CONFIG_BOOTLOADER_MCUBOOT
	/* swap-using-move: confirm ourselves so we don't get reverted, then
	 * arm a permanent swap to the OTHER slot for the next reset. */
	if (!boot_is_img_confirmed()) {
		boot_write_img_confirmed();
	}
	boot_request_upgrade(BOOT_UPGRADE_PERMANENT);
	#endif

	while (1) {
		ret = gpio_pin_toggle_dt(&led);
		if (ret < 0) {
			return 0;
		}

		led_state = !led_state;
		printf("LED state: %s\n", led_state ? "ON" : "OFF");
		k_msleep(SLEEP_TIME_MS);
	}
	return 0;
}
```
